
#include "stm32f4xx_it.h"
#include <stdio.h>


#define ERR_INFO "\r\nEnter HardFault_Handler, System Halt.\r\n"

extern __IO uint8_t ubPreemptionOccurred;
extern __IO uint8_t ubPreemptionPriorityValue; 
/*
*********************************************************************************************************
*	Cortex-M3 内核异常中断服务程序
*********************************************************************************************************
*/

/*
*********************************************************************************************************
*	函 数 名: NMI_Handler
*	功能说明: 不可屏蔽中断服务程序。
*	形    参: 无
*	返 回 值: 无
*********************************************************************************************************
*/
void NMI_Handler(void)
{
}

/*
*********************************************************************************************************
*	函 数 名: HardFault_Handler
*	功能说明: 硬件故障中断服务程序。其他异常处理被关闭，而又发生了异常，则触发。
*			  执行异常处理时，发生了异常，则触发。复位时默认使能。
*	形    参: 无
*	返 回 值: 无
*********************************************************************************************************
*/
void HardFault_Handler(void)
{
#if 1
  const char *pError = ERR_INFO;
  uint8_t i;

  for (i = 0; i < sizeof(ERR_INFO); i++)
  {
     USART1->DR = pError[i];
     /* 等待发送结束 */
     while ((USART1->SR & USART_FLAG_TC) == (uint16_t)RESET);
  }
#endif

  /* 当硬件失效异常发生时进入死循环 */
  while (1)
  {
  }
}

/*
*********************************************************************************************************
*	函 数 名: MemManage_Handler
*	功能说明: 内存管理异常中断服务程序。违反MPU设定的存储器访问规则时触发。 复位时默认未使能
*	形    参: 无
*	返 回 值: 无
*********************************************************************************************************
*/
void MemManage_Handler(void)
{
  /* 当内存管理异常发生时进入死循环 */
  while (1)
  {
  }
}

/*
*********************************************************************************************************
*	函 数 名: BusFault_Handler
*	功能说明: 总线访问异常中断服务程序。取指令、数据读写、堆栈操作出现异常。 复位时默认未使能
*	形    参: 无
*	返 回 值: 无
*********************************************************************************************************
*/
void BusFault_Handler(void)
{
  /* 当总线异常时进入死循环 */
  while (1)
  {
  }
}

/*
*********************************************************************************************************
*	函 数 名: UsageFault_Handler
*	功能说明: 用法错误中断服务程序。执行未定义指令、非对齐操作、除零时触发。 复位时默认未使能
*	形    参: 无
*	返 回 值: 无
*********************************************************************************************************
*/
void UsageFault_Handler(void)
{
  /* 当用法异常时进入死循环 */
  while (1)
  {
  }
}

/*
*********************************************************************************************************
*	函 数 名: SVC_Handler
*	功能说明: 通过SWI指令的系统服务调用中断服务程序。
*	形    参: 无
*	返 回 值: 无
*********************************************************************************************************
*/
void SVC_Handler(void)
{
}

/*
*********************************************************************************************************
*	函 数 名: SysTick_Handler
*	功能说明: 嘀嗒定时器中断服务程序。
*	形    参: 无
*	返 回 值: 无
*********************************************************************************************************
*/
void SysTick_Handler(void)
{
	/* 如果按键K1中断被嘀嗒定时器抢占 */
	if(NVIC_GetActive(EXTI3_IRQn) != 0)
	{
		ubPreemptionOccurred = 1;
	}
}

/*
*********************************************************************************************************
*	函 数 名: DebugMon_Handler
*	功能说明: 调试监视器中断服务程序。
*	形    参: 无
*	返 回 值: 无
*********************************************************************************************************
*/
void DebugMon_Handler(void)
{
}

/*
*********************************************************************************************************
*	函 数 名: PendSV_Handler
*	功能说明: 可挂起的系统服务调用中断服务程序。
*	形    参: 无
*	返 回 值: 无
*********************************************************************************************************
*/
void PendSV_Handler(void)
{
}

/*
*********************************************************************************************************
*	函 数 名: EXTI9_5_IRQHandler
*	功能说明: 外部中断服务程序
*	形    参：无
*	返 回 值: 无
*********************************************************************************************************
*/
extern void Delay(__IO uint32_t nCount);
void EXTI3_IRQHandler(void)
{

//	if(EXTI_GetITStatus(EXTI_Line3) != RESET)
//	{	
//		
//		EXTI_ClearITPendingBit(EXTI_Line3); /* 清除中断标志位 */
//		
//	}
	
	/* 按键K2按下 */
	if(EXTI_GetITStatus(EXTI_Line3) != RESET)
	{	
		/* 这里简单的做一个延迟，防止按键抖动造成多次进入中断 */
		Delay(10000000);
		/* 产生嘀嗒定时器中断 */
		SCB->ICSR |= 0x04000000;
		EXTI_ClearITPendingBit(EXTI_Line3); /* 清除中断标志位 */
		printf("K2按键按下\r\n");
	}
			   
}

/*
*********************************************************************************************************
*	函 数 名: EXTI15_10_IRQHandler
*	功能说明: 外部中断服务程序
*	形    参：无
*	返 回 值: 无
*********************************************************************************************************
*/
void EXTI2_IRQHandler(void)
{
	NVIC_InitTypeDef NVIC_InitStructure;
	
//	if(EXTI_GetITStatus(EXTI_Line2) != RESET)
//	{	
//		
//		EXTI_ClearITPendingBit(EXTI_Line2); /* 清除中断标志位 */
//	}
//	
	/* 按键K3按下 */
	if(EXTI_GetITStatus(EXTI_Line2) != RESET)
	{	
		ubPreemptionPriorityValue = !ubPreemptionPriorityValue;
		ubPreemptionOccurred = 0;
		
		/* 这里简单的做一个延迟，防止按键抖动造成多次进入中断 */
		Delay(10000000);
		/* 修改K1按键中断的优先级 */
		NVIC_InitStructure.NVIC_IRQChannel = EXTI2_IRQn;
		NVIC_InitStructure.NVIC_IRQChannelPreemptionPriority = ubPreemptionPriorityValue;
		NVIC_InitStructure.NVIC_IRQChannelSubPriority = 0;
		NVIC_InitStructure.NVIC_IRQChannelCmd = ENABLE;
		NVIC_Init(&NVIC_InitStructure);

		/* 配置嘀嗒定时器的抢占优先级和子优先级 */
		NVIC_SetPriority(SysTick_IRQn, NVIC_EncodePriority(NVIC_GetPriorityGrouping(), !ubPreemptionPriorityValue, 0)); 		
		EXTI_ClearITPendingBit(EXTI_Line2); /* 清除中断标志位 */
		printf("K3按键按下，嘀嗒定时器和K3按键的抢占优先级都翻转\r\n");
		if(ubPreemptionPriorityValue == 0)
		{
			printf("滴答定时器的中断不可以抢占K2按键中断，按下K2按键两个LED不闪烁\r\n");
		}
		else
		{
			printf("滴答定时器的中断可以抢占K2按键中断，按下K2按键两个LED闪烁\r\n");
		}
	}
	
	if(EXTI_GetITStatus(EXTI_Line2) != RESET)
	{	
		
		EXTI_ClearITPendingBit(EXTI_Line2); /* 清除中断标志位 */
	}
			   
}

/*
*********************************************************************************************************
*	函 数 名: EXTI3_IRQHandler
*	功能说明: 外部中断服务程序
*	形    参：无
*	返 回 值: 无
*********************************************************************************************************
*/
//void EXTI3_IRQHandler(void)
//{

//	if(EXTI_GetITStatus(EXTI_Line3) != RESET)
//	{	
//		
//		EXTI_ClearITPendingBit(EXTI_Line3); /* 清除中断标志位 */
//	}
//			   
//}

/*
*********************************************************************************************************
*	函 数 名: EXTI2_IRQHandler
*	功能说明: 外部中断服务程序
*	形    参：无
*	返 回 值: 无
*********************************************************************************************************
*/
//void EXTI2_IRQHandler(void)
//{

//	if(EXTI_GetITStatus(EXTI_Line2) != RESET)
//	{	
//	
//		EXTI_ClearITPendingBit(EXTI_Line2); /* 清除中断标志位 */
//	}
//			   
//}
